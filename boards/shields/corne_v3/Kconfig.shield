## boards/shields/corne_v3/Kconfig.shield
```kconfig
config SHIELD_CORNE_V3_DONGLE
	def_bool $(shields_list_contains,corne_v3_dongle)
```

## boards/shields/corne_v3_dongle/corne_v3_dongle.defconfig
```kconfig
CONFIG_ZMK_KEYBOARD_NAME="Corne_v3"

# Включаем мышь, так как она есть в keymap
CONFIG_ZMK_MOUSE=y

# Настройки центрального устройства (донгла)
CONFIG_ZMK_SPLIT_ROLE_CENTRAL=y
CONFIG_ZMK_SPLIT_BLE_CENTRAL_PERIPHERALS=2

# Увеличиваем лимиты для стабильности
CONFIG_BT_MAX_CONN=5
CONFIG_BT_MAX_PAIRED=5

# CONFIG_ZMK_RGB_UNDERGLOW=y
```
